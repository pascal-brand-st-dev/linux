## drivers/smaf/Kconfig
```kconfig
config SMAF
	tristate "Secure Memory Allocation Framework"
	depends on DMA_SHARED_BUFFER
	help
	  Choose this option to enable Secure Memory Allocation Framework

config SMAF_CMA
	tristate "SMAF CMA allocator"
	depends on SMAF
	help
	  Choose this option to enable CMA allocation within SMAF

config SMAF_OPTEE_ALLOCATOR
	tristate "SMAF OPTEE Allocator"
	depends on SMAF && TEE && OPTEE
	help
	  Choose this option to enable Secure allocation from OP-TEE within SMAF

config SMAF_FAKE_SECURE
	tristate "SMAF fake secure module"
	depends on SMAF
	help
	  Choose this option to enable fake secure module for test purpose
```
